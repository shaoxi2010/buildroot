## package/dfbterm/Config.in
```kconfig
config BR2_PACKAGE_DFBTERM
	bool "DFBTerm"
	depends on BR2_PACKAGE_DIRECTFB2
	select BR2_PACKAGE_DIRECTFB2_LITE
	help
	  DFBTerm is a terminal emulator runnning on DirectFB2 and
	  based on libzvt.

	  libzvt (Zed's virtual terminal emulation library) is
	  included directly in the source code, although it is
	  possible to use the system's libzvt library.
```

## package/directfb2-csource/Config.in
```kconfig
config BR2_PACKAGE_DIRECTFB2_CSOURCE
	bool "directfb2-csource"
	depends on BR2_PACKAGE_DIRECTFB2
	help
	  directfb2-csource is a data header file generation utility for
	  DirectFB2 code.
```

## package/directfb2-examples/Config.in
```kconfig
menuconfig BR2_PACKAGE_DIRECTFB2_EXAMPLES
	bool "DirectFB2 examples"
	depends on BR2_PACKAGE_DIRECTFB2
	select BR2_PACKAGE_DIRECTFB2_CSOURCE
	help
	  The DirectFB2-examples package contains a set of simple
	  DirectFB2 applications that can be used to test and
	  demonstrate various DirectFB2 features. Note that DirectFB2
	  is a fork of DirectFB, as the original DirectFB stopped
	  being maintained in 2016.

	  The official DirectFB2 website can be visited via
	  https://directfb2.github.io/

if BR2_PACKAGE_DIRECTFB2_EXAMPLES

choice
	prompt "DirectFBGL interface version"
	default BR2_PACKAGE_DIRECTFB2_EXAMPLES_GL_VERSION_NULL

config BR2_PACKAGE_DIRECTFB2_EXAMPLES_GL_VERSION_NULL
	bool "-"
comment "Build without version flag specified"

config BR2_PACKAGE_DIRECTFB2_EXAMPLES_GL_VERSION_1
	bool "1"
comment "Pass -Ddirectfbgl=1 to the Meson build system"

config BR2_PACKAGE_DIRECTFB2_EXAMPLES_GL_VERSION_2
	bool "2"
comment "Pass -Ddirectfbgl=2 to the Meson build system"

endchoice

config BR2_PACKAGE_DIRECTFB2_EXAMPLES_GL
	string "PATH to OpenGL header"
	default ""

config BR2_PACKAGE_DIRECTFB2_EXAMPLES_GL_CFLAGS
	string "CFLAGS of the OpenGL implementation"
	default ""

config BR2_PACKAGE_DIRECTFB2_EXAMPLES_GL_LDFLAGS
	string "LDFLAGS of the OpenGL implementation"
	default ""

# Disabled for now as directfb2-csource currently does not generate
# pkgconfig file
#
# choice
#	prompt "Select font header for DirectFB2 examples"
#	default BR2_PACKAGE_DIRECTFB2_EXAMPLES_FONT_HEADER_DISABLED
#
# config BR2_PACKAGE_DIRECTFB2_EXAMPLES_FONT_HEADER_DISABLED
#	bool "disabled"
#
# config BR2_PACKAGE_DIRECTFB2_EXAMPLES_FONT_HEADER_DGIFF
#	bool "dgiff"
#
# config BR2_PACKAGE_DIRECTFB2_EXAMPLES_FONT_HEADER_ttf
#	bool "ttf"
#
#endchoice

# Disabled for now as directfb2-csource currently does not generate
# pkgconfig file
#
# choice
#	prompt "Select image header for DirectFB2 examples"
#	default BR2_PACKAGE_DIRECTFB2_EXAMPLES_DISABLED
#
# config BR2_PACKAGE_DIRECTFB2_EXAMPLES_DISABLED
#	bool "disabled"
#
# config BR2_PACKAGE_DIRECTFB2_EXAMPLES_DFIFF
#	bool "dfiff"
#
# config BR2_PACKAGE_DIRECTFB2_EXAMPLES_PNG
#	bool "png"
#
# endchoice

# Disabled for now as directfb2-csource currently does not generate
# pkgconfig file
#
# choice
#	prompt "Select video header for DirectFB2 examples"
#	default BR2_PACKAGE_DIRECTFB2_EXAMPLES_VIDEO_HEADERS_DISABLED
#
# config BR2_PACKAGE_DIRECTFB2_EXAMPLES_VIDEO_HEADERS_DISABLED
#	bool "disabled"
#
# config BR2_PACKAGE_DIRECTFB2_EXAMPLES_VIDEO_HEADERS_DFVFF
#	bool "dfvff"
#
# config BR2_PACKAGE_DIRECTFB2_EXAMPLES_VIDEO_HEADERS_M2V
#	bool "m2v"
#
# config BR2_PACKAGE_DIRECTFB2_EXAMPLES_VIDEO_HEADERS_264
#	bool "264"
#
# endchoice

endif # BR2_PACKAGE_DIRECTFB2_EXAMPLES
```

## package/directfb2-gles/Config.in
```kconfig
config BR2_PACKAGE_DIRECTFB2_GLES
	bool "directfb2-gles"
	depends on BR2_PACKAGE_DIRECTFB2 && BR2_PACKAGE_HAS_LIBGLES
	help
	  DirectFB2-gles2 contains the OpenGL ES 2.0 GFX driver for DirectFB2.
comment "directfb-tslib available if tslib is enabled"
	depends on !BR2_PACKAGE_HAS_LIBGLES || !BR2_PACKAGE_DIRECTFB2
```

## package/directfb2-lite/Config.in
```kconfig
config BR2_PACKAGE_DIRECTFB2_LITE
	bool "directfb2-lite"
	depends on BR2_PACKAGE_DIRECTFB2
	help
	  LiTE stands for Lightweight Toolkit Enabler and is a simple
	  user interface library on top of DirectFB2. Widgets can be
	  used with a default theme, or with its own custom theme.
```

## package/directfb2-media/Config.in
```kconfig
config BR2_PACKAGE_DIRECTFB2_MEDIA
	bool "directfb2-media"
	depends on BR2_PACKAGE_DIRECTFB2
	help
	  DirectFB2-media contains additional font/image/music/video
	  providers for DirectFB2.
```

## package/directfb2-tslib/Config.in
```kconfig
config BR2_PACKAGE_DIRECTFB2_TSLIB
	bool "directfb2-tslib"
	depends on BR2_PACKAGE_DIRECTFB2 && BR2_PACKAGE_TSLIB
	help
	  DirectFB2-tslib contains tslib input plugin.
comment "directfb-tslib available if tslib is enabled"
	depends on !BR2_PACKAGE_TSLIB || !BR2_PACKAGE_DIRECTFB2
```

## package/directfb2/Config.in
```kconfig
menuconfig BR2_PACKAGE_DIRECTFB2
	bool "DirectFB2"
	default n
	help
	  DirectFB2 is a fork of DirectFB (Direct Frame Buffer) whose
	  purpose is to preserve and maintain the DirectFB graphics
	  backend, particularly for use on embedded systems.

	  The official DirectFB2 website can be visited via
	  https://directfb2.github.io/

if BR2_PACKAGE_DIRECTFB2

menu "DirectFB2 Options"

config BR2_PACKAGE_DIRECTFB2_DEBUG
	bool "Enable Debug support"

config BR2_PACKAGE_DIRECTFB2_DRMKMS
	bool "Enable Linux DRM/KMS support"
	depends on BR2_PACKAGE_LIBDRM

comment "Enable Linux DRM/KMS support if libdrm is enabled"
	depends on !BR2_PACKAGE_LIBDRM

config BR2_PACKAGE_DIRECTFB2_FBDEV
	bool "Enable Linux Framebuffer support"

config BR2_PACKAGE_DIRECTFB2_LINUX_INPUT
	bool "Enable Linux input support"

if BR2_X86_CPU_HAS_MMX
config BR2_PACKAGE_DIRECTFB2_MMX
	bool "Enable MMX assembly support"
	default y
endif #	BR2_X86_CPU_HAS_MMX

config BR2_PACKAGE_DIRECTFB2_MULTI
	bool "Enable multi application support"

config BR2_PACKAGE_DIRECTFB2_MULTI_KERNEL
	bool "Enable Linux fusion device support for multi application"
	select BR2_PACKAGE_DIRECTFB2_MULTI

# if BR2_ARM_CPU_HAS_NEON
# config BR2_PACKAGE_DIRECTFB2_NEON
#	bool "Enable NEON assembly support"
#	default y
# endif # BR2_ARM_CPU_HAS_NEON
#
# DirectFB2 currently has issues enabling NEON. For more details, see:
# https://github.com/directfb2/DirectFB2/issues/142

config BR2_PACKAGE_DIRECTFB2_NETWORK
	bool "Enable network support"

config BR2_PACKAGE_DIRECTFB2_SENTINELS
	bool "Enable surface sentinels at the end of chunks in video memory"

config BR2_PACKAGE_DIRECTFB2_SMOOTH_SCALING
	bool "Enable smooth scaling support"

endmenu

menu "DirectFB2 Applications"
source "package/directfb2-examples/Config.in"
source "package/dfbterm/Config.in"
endmenu

menu "DirectFB2 Utilities"
source "package/directfb2-media/Config.in"
source "package/directfb2-tools/Config.in"
source "package/directfb2-csource/Config.in"
source "package/directfb2-lite/Config.in"
endmenu

menu "DirectFB2 Plugins"
source "package/directfb2-tslib/Config.in"
source "package/directfb2-gles/Config.in"
endmenu

endif # BR2_PACKAGE_DIRECTFB2
```

## package/freetds/Config.in
```kconfig
config BR2_PACKAGE_FREETDS
	bool "freetds"
	depends on !BR2_STATIC_LIBS # uses dlfcn.h
	depends on BR2_PACKAGE_UNIXODBC
	help
	  FreeTDS is a set of libraries for Unix and Linux that allows your
	  programs to natively talk to Microsoft SQL Server and Sybase databases,
	  in addition to other databases.

comment "freetds need unixodbc"
	depends on !BR2_PACKAGE_UNIXODBC
```

## package/labwc/Config.in
```kconfig
comment "labwc needs wayland support"
	depends on !BR2_PACKAGE_WAYLAND || !BR2_PACKAGE_WAYLAND_PROTOCOLS

config BR2_PACKAGE_LABWC
	bool "labwc"
	depends on !BR2_STATIC_LIBS # wayland
	depends on BR2_TOOLCHAIN_HAS_THREADS # wayland
	depends on BR2_TOOLCHAIN_HEADERS_AT_LEAST_3_0
	select BR2_PACKAGE_WLROOT
	select BR2_PACKAGE_WAYLAND
	select BR2_PACKAGE_WAYLAND_PROTOCOLS
	select BR2_PACKAGE_LIBINPUT
	select BR2_PACKAGE_LIBXKBCOMMON
	select BR2_PACKAGE_LIBGLIB2
	select BR2_PACKAGE_PANGO
	select BR2_PACKAGE_LIBXML2
	select BR2_PACKAGE_CAIRO
	select BR2_PACKAGE_CAIRO_PNG
	select BR2_PACKAGE_LIBPNG
	help
	  Labwc stands for Lab Wayland Compositor, where lab can mean any of the following:
	  * Lightweight And Box-inspired
	  * sense of experimentation and treading new ground
	  * inspired by BunsenLabs and ArchLabs
	  * your favorite pet

	  https://github.com/labwc/labwc

if BR2_PACKAGE_LABWC

config BR2_PACKAGE_LABWC_XWAYLAND
	bool "labwc-xwayland"
	select BR2_PACKAGE_WLROOTS_XWAYLAND
	select BR2_PACKAGE_XORG7
	select BR2_PACKAGE_LIBXCB
	select BR2_PACKAGE_XWAYLAND
	help
	  XWayland is a server-side implementation of the X11 protocol
	  that allows traditional X11 clients to be run natively on Wayland
	  compositors.
	  
endif
```

## package/libgl4es/Config.in
```kconfig
config BR2_PACKAGE_LIBGL4ES
	bool "libgl4es"
	depends on BR2_PACKAGE_HAS_LIBGLES
	select BR2_PACKAGE_PROVIDES_LIBGL
	help
	  GL4ES - OpenGL for GLES Hardware.

	  https://github.com/ptitSeb/gl4es

comment "libgl4es needs opengles support"
	depends on !BR2_PACKAGE_HAS_LIBGLES
```

## package/picom/Config.in
```kconfig
config BR2_PACKAGE_PICOM
	bool "picom"
	depends on BR2_PACKAGE_XORG7
	select BR2_PACKAGE_XLIB_LIBX11 # libx11
	select BR2_PACKAGE_LIBXCB # libx11-xcb
	select BR2_PACKAGE_XCB_PROTO # xproto
	select BR2_PACKAGE_XCB_UTIL # xcb-util
	select BR2_PACKAGE_XLIB_LIBXDAMAGE # xcb-damage
	select BR2_PACKAGE_XLIB_LIBXFIXES # xcb-xfixes
	select BR2_PACKAGE_XCB_UTIL_RENDERUTIL # xcb-render-util
	select BR2_PACKAGE_XLIB_LIBXRENDER # xcb-render
	select BR2_PACKAGE_XLIB_LIBXRANDR # xcb-randr
	select BR2_PACKAGE_XLIB_LIBXCOMPOSITE # xcb-composite
	select BR2_PACKAGE_XCB_UTIL_IMAGE # xcb-image
	select BR2_PACKAGE_XLIB_LIBXPRESENT # xcb-present
	select BR2_PACKAGE_PIXMAN # pixman
	select BR2_PACKAGE_LIBCONFIG # libconfig
	select BR2_PACKAGE_LIBEV # libev
	select BR2_PACKAGE_UTHASH # uthash
	default n
	help
	  picom is a compositor for X, and a fork of Compton.

	  The official picom website can be visited via
	  https://github.com/yshui/picom

comment "picom requires X11"
	depends on !BR2_PACKAGE_XORG7

if BR2_PACKAGE_PICOM
	config BR2_PICOM_USE_OPENGL
		bool "picom OpenGL backend"
		depends on BR2_PACKAGE_HAS_LIBGL
		select BR2_PACKAGE_LIBEPOXY # libepoxy
		default n

	comment "picom opengl backend requires OpenGL support"
		depends on !BR2_PACKAGE_HAS_LIBGL
endif # BR2_PACKAGE_PICOM
```

## package/qt5/qvirtualkeyboard/Config.in
```kconfig
config BR2_PACKAGE_QVIRTUALKEYBOARD
	bool "QVirtualKeyboard"
	depends on BR2_PACKAGE_QT5BASE_WIDGETS
	help
	  Qt Virtual Keyboard is a virtual keyboard for Qt applications.
	  It is based on the Qt Widget.

comment "QVirtualKeyboard is need Qt5Widget"
	depends on !BR2_PACKAGE_QT5BASE_WIDGETS
```

## package/uthash/Config.in
```kconfig
config BR2_PACKAGE_UTHASH
    bool "uthash"
    help
      The uthash library is a C hash table library.
```

## package/xlibinput-calibrator/Config.in
```kconfig
config BR2_PACKAGE_XLIBINPUT_CALIBRATOR
	bool "xlibinput-calibrator"
	depends on BR2_PACKAGE_XORG7
	depends on BR2_INSTALL_LIBSTDCPP
	select BR2_PACKAGE_XLIB_LIBX11 # libx11
	select BR2_PACKAGE_XLIB_LIBXI # libxi
	select BR2_PACKAGE_XLIB_LIBXRANDR # libxrandr
	help
	  The aim of this project is to allow to calibrate a touch screen when X11 relies on libinput. 
	  For older X11, which doesn't relies on libinput, you have to use the old xinput_calibrator.

	  https://github.com/kreijack/xlibinput_calibrator

comment "xlibinput-calibrator need libstdc++ and X11 to be built."
	depends on !BR2_PACKAGE_XORG7 || !BR2_INSTALL_LIBSTDCPP
```
